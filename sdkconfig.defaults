## sdkconfig.defaults
```kconfig
# --- 基础蓝牙 (保持保留但默认不启动) ---
CONFIG_BT_ENABLED=y
CONFIG_BT_NIMBLE_ENABLED=y
CONFIG_BT_CONTROLLER_ENABLED=y

# --- 强制关闭 Wi-Fi/蓝牙共存逻辑 (解决 Coexist!!! 报错) ---
CONFIG_ESP_WIFI_SOFTAP_SAE_SUPPORT=n
CONFIG_SW_COEXIST_ENABLE=n

# --- 内存与性能优化 ---
CONFIG_BT_NIMBLE_MSYS_1_BT_POOL_SZ=4096
CONFIG_COMPILER_OPTIMIZATION_SIZE=y

# --- Wi-Fi 兼容性增强 (回归原生) ---
CONFIG_ESP_WIFI_AMPDU_TX_ENABLED=n
CONFIG_ESP_WIFI_AMPDU_RX_ENABLED=n
CONFIG_ESP_PHY_MAX_WIFI_TX_POWER=20

# --- 分区表与字体 ---
CONFIG_PARTITION_TABLE_CUSTOM=y
CONFIG_PARTITION_TABLE_CUSTOM_FILENAME="partitions.csv"
CONFIG_PARTITION_TABLE_FILENAME="partitions.csv"
CONFIG_LV_FONT_MONTSERRAT_10=y
CONFIG_LV_FONT_MONTSERRAT_12=y
CONFIG_LV_FONT_MONTSERRAT_14=y
```
